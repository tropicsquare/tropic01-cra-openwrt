## features/core/libtropic-pkcs11/Config.in
```kconfig
config PACKAGE_libtropic-pkcs11
	bool "libtropic-pkcs11 - PKCS#11 module for TROPIC01"
	depends on PACKAGE_libtropic
	select PACKAGE_libopenssl
	help
	  NOTE: For testing with pkcs11-tool, also enable:
	  Utilities -> opensc
	  A PKCS#11 Cryptoki module for the TROPIC01 secure element.
	  
	  This library provides standard PKCS#11 interface for:
	  - Hardware random number generation (TRNG)
	  - Secure data storage (512 slots × 444 bytes in R-MEM)
	  - ECC key generation (P-256/Ed25519) in 32 key slots
	  - Digital signatures (ECDSA/EdDSA, private keys stay on chip)
	  
	  Compatible with pkcs11-tool, OpenSSL, Firefox, and other
	  PKCS#11-aware applications. Enables using TROPIC01 as a
	  hardware security module (HSM) for cryptographic operations.
	  
	  The module is installed as /usr/lib/libtropic_pkcs11.so
	  
	  Default USB device: /dev/ttyACM0
	  
	  https://github.com/tropicsquare/libtropic-pkcs11
```

## features/core/opensc/Config.in
```kconfig
config PACKAGE_opensc
	bool "opensc - Smart card utilities (pkcs11-tool)"
	depends on PACKAGE_libopensc
	default n
	help
	  OpenSC provides utilities to work with smart cards and PKCS#11 modules.
	  
	  This minimal build includes:
	  - pkcs11-tool: Test and debug PKCS#11 modules
	  - opensc-tool: Query smart card information
	  - pkcs15-tool: Manage PKCS#15 data
	  
	  Built without PC/SC middleware for reduced dependencies.
	  Perfect for testing PKCS#11 modules like libtropic-pkcs11.
	  
	  https://github.com/OpenSC/OpenSC

config PACKAGE_libopensc
	bool "libopensc - OpenSC PKCS#11 library"
	select PACKAGE_libopenssl
	select PACKAGE_zlib
	default n
	help
	  OpenSC libraries for PKCS#11 and smart card operations.
	  
	  This is a minimal build without PC/SC middleware support,
	  suitable for use with external PKCS#11 modules.
```

## features/core/pkcs11-helper/Config.in
```kconfig
config PACKAGE_pkcs11-helper
	bool "pkcs11-helper - PKCS#11 helper library"
	depends on PACKAGE_libopenssl
	help
	  pkcs11-helper makes it easy for application developers to add PKCS#11
	  support to their software.  It handles dynamic loading of PKCS#11
	  providers, session and slot management, object enumeration and
	  sign/decrypt operations needed for TLS client authentication.

	  Required by openvpn_openssl for TROPIC01 PKCS#11 hardware-key support.

	  https://github.com/OpenSC/pkcs11-helper
```

## features/core/pkcs11-test/Config.in
```kconfig
config PACKAGE_pkcs11-test
	bool "pkcs11-test - Simple PKCS#11 testing utility"
	default n
	help
	  A lightweight utility for testing PKCS#11 modules.
	  
	  This is a minimal alternative to pkcs11-tool from OpenSC,
	  designed for basic PKCS#11 module testing without heavy
	  dependencies. Perfect for embedded systems.
	  
	  Features:
	  - Load and test PKCS#11 modules
	  - Display module information
	  - Test init/finalize functions
	  - Very small footprint (~10KB)
	  
	  Use this to quickly test libtropic-pkcs11 or any other
	  PKCS#11 module without installing full OpenSC.
	  
	  For full PKCS#11 functionality, use opensc package instead.
```

## features/core/tropicctl/Config.in
```kconfig
config PACKAGE_tropicctl
	bool "tropicctl - command-line tool for the TROPIC01 secure element"
	depends on PACKAGE_libtropic
	select PACKAGE_libopenssl
	help
	  tropicctl talks to a TROPIC01 secure element over Linux SPI and GPIO:
	  chip and firmware information, random numbers, ECC keys, R-MEM data,
	  pairing keys, the chip configuration, MAC-and-Destroy PIN verification
	  and monotonic counters. Every command has a safety class; commands that
	  cannot be undone need an explicit confirmation flag.

	  Started under the name lt-util (a symlink this package installs) it
	  accepts the old lt-util command line.
```

## features/cra-03-key-storage/openvpn/Config.in
```kconfig
config PACKAGE_openvpn_openssl
	bool "openvpn (OpenSSL + PKCS#11) - VPN client with TROPIC01 hardware keys"
	depends on PACKAGE_libopenssl && PACKAGE_libpkcs11-helper
	select PACKAGE_kmod-tun
	select PACKAGE_libpkcs11-helper
	help
	  OpenVPN client built against OpenSSL with pkcs11-helper support.

	  This variant enables hardware-backed TLS authentication using private
	  keys and certificates stored in the TROPIC01 secure element via the
	  standard PKCS#11 interface.  The private key is generated inside and
	  never extracted from the TROPIC01 chip.

	  Key OpenVPN directives for TROPIC01:
	    pkcs11-providers  /usr/lib/libtropic_pkcs11.so
	    pkcs11-id         <URI from pkcs11-tool -O>
	    pkcs11-pin-cache  300

	  A fully-commented sample configuration is installed as:
	    /etc/openvpn/tropic01-pkcs11-client.conf

	  Requires:
	    Libraries -> libtropic-pkcs11
	    Libraries -> pkcs11-helper

config PACKAGE_openvpn_wolfssl
	bool "openvpn (wolfSSL, no PKCS#11) - lightweight VPN client"
	depends on PACKAGE_libwolfssl
	select PACKAGE_kmod-tun
	help
	  OpenVPN client built against wolfSSL for a smaller binary footprint.

	  PKCS#11 / TROPIC01 hardware-key support is NOT available in this
	  variant.  Select openvpn_openssl above for TROPIC01 integration.
```
