## features/core/libtropic/Config.in
```kconfig
config PACKAGE_libtropic
	bool "libtropic - TROPIC01 SDK library"
	depends on PACKAGE_libmbedtls
	help
	  Libtropic is a C SDK library for application development with TROPIC01
	  secure element. It provides APIs for secure communication, cryptographic
	  operations, and hardware abstraction for TROPIC01 chip integration.
	  
	  This package builds libtropic as a static library. Applications need to
	  configure the appropriate HAL (Hardware Abstraction Layer) and CAL 
	  (Crypto Abstraction Layer) when linking against this library.
	  
	  Supported platforms:
	    - Linux SPI
	    - POSIX TCP (for testing with model)
	    - POSIX USB dongle
	  
	  Crypto backend:
	    - MbedTLS v4
	  
	  https://github.com/tropicsquare/libtropic
```

## features/core/lt-util/Config.in
```kconfig
config PACKAGE_lt-util
	bool "lt-util - Command line utility for TROPIC01 secure element"
	depends on PACKAGE_libtropic
	help
	  Command line utility for interfacing with TROPIC01 chip.
	  
	  Provides access to TROPIC01 secure element features:
	  - Random number generation
	  - ECC key management (generate, install, sign)
	  - Memory operations
	  - Chip identification
	  
	  Supports Linux SPI interface for direct chip communication.
```
